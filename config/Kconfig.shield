## config/Kconfig.shield
```kconfig
# Copyright (c) 2020 The ZMK Contributors
# SPDX-License-Identifier: MIT

config SHIELD_ALGEBOARD_LEFT
	def_bool $(shields_list_contains,algeboard_left)

config SHIELD_ALGEBOARD_RIGHT
	def_bool $(shields_list_contains,algeboard_right)
```
